## data_ingestion_layer/firmware/main/Kconfig.projbuild
```kconfig
menu "Network Configuration"
    config WIFI_SSID
        string "WiFi SSID"
        default "your-ssid"
        help
            The SSID of the WiFi network to connect to.

    config WIFI_PASSWORD
        string "WiFi Password"
        default "your-password"
        help
            The password of the WiFi network.

    config SERVER_HOST
        string "Server IP Address"
        default "192.168.1.100"
        help
            The IP address of the respeaker_service.py server.

    config SERVER_PORT
        int "Server Port"
        default 8010
        help
            The port number of the respeaker_service.py server.
endmenu

choice BOARD_TYPE
    prompt "Board Type"
    default BOARD_RESPEAKER_LITE
    help
        Select the ReSpeaker board type.

    config BOARD_RESPEAKER_LITE
        bool "ReSpeaker Lite"

    config BOARD_RESPEAKER_XVF3800
        bool "ReSpeaker XVF3800"

endchoice

menu "Benchmark"
    config ENABLE_BENCHMARK
        bool "Enable feature extractor benchmark"
        default n
        help
            Enable this option to run the feature extractor benchmark on startup.
endmenu
```
